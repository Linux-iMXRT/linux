## Documentation/devicetree/bindings/clock/imxrt-clock.yaml
```yaml
# SPDX-License-Identifier: (GPL-2.0-only OR BSD-2-Clause)
%YAML 1.2
---
$id: http://devicetree.org/schemas/clock/imxrt-clock.yaml#
$schema: http://devicetree.org/meta-schemas/core.yaml#

title: Clock bindings for Freescale i.MXRT

maintainers:
  - Giulio Benetti <giulio.benetti@benettiengineering.com>
  - Jesse Taube <Mr.Bossman075@gmail.com>

description: |
  The clock consumer should specify the desired clock by having the clock
  ID in its "clocks" phandle cell. See include/dt-bindings/clock/imxrt*-clock.h
  for the full list of i.MXRT clock IDs.
properties:
  compatible:
    oneOf:
      - enum:
          - fsl,imxrt1050-ccm

  reg:
    maxItems: 1

  interrupts:
    maxItems: 1

  clocks:
    minItems: 1

  clock-names:
    minItems: 1

  '#clock-cells':
    const: 1

required:
  - compatible
  - reg
  - interrupts
  - clocks
  - clock-names
  - '#clock-cells'

additionalProperties: false

examples:
  - |
    anatop: anatop@400d8000 {
      compatible = "fsl,imxrt-anatop";
      reg = <0x400d8000 0x4000>;
    };

    ccm@400fc000 {
      compatible = "fsl,imxrt1050-ccm";
      reg = <0x400fc000 0x4000>;
      interrupts = <95>,<96>;
      clocks = <&osc>;
      clock-names = "osc";
      #clock-cells = <1>;
    };

    gpt: timer@401ec000 {
      compatible = "fsl,imx53-gpt", "fsl,imx31-gpt";
      reg = <0x401ec000 0x4000>;
      interrupts = <100>;
      clocks = <&clks 3>;
      clock-names = "per";
    };
```
